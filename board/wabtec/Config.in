## board/wabtec/Config.in
```kconfig
choice
	prompt "Wabtec target board"
	default BR2_BOARD_DLC_NEXT
	help
	  Select the target Wabtec board variant. Each board selects a set
	  of BR2_SYSTEM_* flags that the post-build and image generation
	  scripts consume to gate platform-specific behavior (HW RNG
	  presence, swap requirement, persistent random-seed, ...).

config BR2_BOARD_DLC_NEXT
	bool "DLC-Next (MCF54418, imx-rngc)"
	select BR2_SYSTEM_HAS_HW_RNG
	help
	  DLC-Next door control unit, MCF54418 ColdFire SoC with the
	  imx-rngc hardware RNG block (RNGB IP), 256 MB RAM. The HW RNG
	  is auto-drained by the kernel hwrng kthread, so no userspace
	  random-seed persistence is required.

config BR2_BOARD_DLC2NG
	bool "DLC2NG (MCF54415, no HW RNG)"
	select BR2_SYSTEM_NEEDS_SWAP
	select BR2_SYSTEM_NEEDS_RANDOM_SEED_PERSIST
	help
	  Legacy DLC2NG door control unit, MCF54415 ColdFire SoC without
	  hardware RNG, 128 MB RAM. Requires a swap region for software
	  package decompression and a persistent random-seed (via busybox
	  seedrng) to bootstrap the kernel CRNG quickly across reboots.

endchoice

config BR2_SYSTEM_HAS_HW_RNG
	bool

config BR2_SYSTEM_NEEDS_SWAP
	bool

config BR2_SYSTEM_NEEDS_RANDOM_SEED_PERSIST
	bool
```

## board/wabtec/configs/m54418_dlc_next_defconfig
```kconfig
BR2_m68k=y
BR2_m68k_cf5441x=y
BR2_PACKAGE_HOST_LINUX_HEADERS_CUSTOM_6_17=y
BR2_UCLIBC_CONFIG="board/wabtec/configs/uClibc-ng.config"
BR2_TOOLCHAIN_BUILDROOT_LOCALE=y
BR2_PTHREAD_DEBUG=y
BR2_TOOLCHAIN_BUILDROOT_CXX=y
BR2_PACKAGE_HOST_GDB=y
BR2_CCACHE=y
BR2_ENABLE_LTO=y
BR2_REPRODUCIBLE=y
BR2_INIT_SYSV=y
BR2_ROOTFS_MERGED_USR=y
BR2_TARGET_GENERIC_ROOT_PASSWD="dhs03987"
BR2_SYSTEM_BIN_SH_BASH=y
BR2_TARGET_GENERIC_GETTY_PORT="ttyS6"
# BR2_TARGET_GENERIC_REMOUNT_ROOTFS_RW is not set
BR2_SYSTEM_DHCP="eth0"
BR2_SYSTEM_DEFAULT_PATH="/bin:/sbin:/usr/bin:/usr/sbin"
BR2_ROOTFS_USERS_TABLES="board/wabtec/common/users_table.txt"
BR2_ROOTFS_OVERLAY="board/wabtec/common/rootfs_overlay"
BR2_ROOTFS_POST_BUILD_SCRIPT="board/wabtec/common/post-build.sh"
BR2_ROOTFS_POST_FAKEROOT_SCRIPT="board/wabtec/scripts/post-fakeroot.sh"
BR2_ROOTFS_POST_IMAGE_SCRIPT="board/wabtec/scripts/post-image.sh"
BR2_ROOTFS_POST_SCRIPT_ARGS="$(JFFS2_OPTS)"
BR2_LINUX_KERNEL=y
BR2_LINUX_KERNEL_CUSTOM_GIT=y
BR2_LINUX_KERNEL_CUSTOM_REPO_URL="$(FY_GITLAB_GLOBAL_REPO_URL)/ftt/doors/standard/bsp/coldfire/kernel.git"
BR2_LINUX_KERNEL_CUSTOM_REPO_VERSION="04e0b70aacd882e381fcf8df4fbb3e4f88b61c75"
BR2_LINUX_KERNEL_PATCH="board/wabtec/patches/"
BR2_LINUX_KERNEL_USE_CUSTOM_CONFIG=y
BR2_LINUX_KERNEL_CUSTOM_CONFIG_FILE="board/wabtec/configs/linux_defconfig"
BR2_PACKAGE_BUSYBOX_CONFIG="board/wabtec/configs/busybox-minimal.config"
BR2_PACKAGE_ALSA_UTILS=y
BR2_PACKAGE_ALSA_UTILS_APLAY=y
BR2_PACKAGE_ALSA_UTILS_SPEAKER_TEST=y
BR2_PACKAGE_GZIP=y
BR2_PACKAGE_GDB=y
BR2_PACKAGE_GDB_SERVER=y
BR2_PACKAGE_GDB_DEBUGGER=y
BR2_PACKAGE_RT_TESTS=y
BR2_PACKAGE_STRACE=y
BR2_PACKAGE_FINDUTILS=y
BR2_PACKAGE_GREP=y
BR2_PACKAGE_MAWK=y
BR2_PACKAGE_SED=y
BR2_PACKAGE_MTD=y
BR2_PACKAGE_MTD_MKFSUBIFS=y
BR2_PACKAGE_SYSSTAT=y
BR2_PACKAGE_UBOOT_TOOLS=y
BR2_PACKAGE_LIBARCHIVE=y
BR2_PACKAGE_CRYPTODEV_LINUX=y
BR2_PACKAGE_LIBSCRYPT=y
BR2_PACKAGE_LIBOPENSSL_BIN=y
BR2_PACKAGE_SQLITE=y
BR2_PACKAGE_LIBFUSE3=y
BR2_PACKAGE_LIBGPIOD2=y
BR2_PACKAGE_LIBGPIOD2_TOOLS=y
BR2_PACKAGE_EXPAT=y
BR2_PACKAGE_JANSSON=y
BR2_PACKAGE_LIBXML2=y
BR2_PACKAGE_LIBCURL=y
BR2_PACKAGE_LIBCURL_CURL=y
BR2_PACKAGE_LIBCURL_VERBOSE=y
BR2_PACKAGE_LIBWEBSOCKETS=y
BR2_PACKAGE_LIBCAP=y
BR2_PACKAGE_LIBDAEMON=y
BR2_PACKAGE_LIBGLIB2=y
BR2_PACKAGE_LINUX_PAM=y
BR2_PACKAGE_LINUX_PAM_LASTLOG=y
BR2_PACKAGE_LIBPAM_NFC=y
BR2_PACKAGE_LIBPAM_RADIUS_AUTH=y
BR2_PACKAGE_LIBPAM_TACPLUS=y
BR2_PACKAGE_CAN_UTILS=y
BR2_PACKAGE_DROPBEAR=y
BR2_PACKAGE_ETHTOOL=y
BR2_PACKAGE_GESFTPSERVER=y
# BR2_PACKAGE_IFUPDOWN_SCRIPTS is not set
BR2_PACKAGE_IPERF3=y
BR2_PACKAGE_IPROUTE2=y
BR2_PACKAGE_NFTABLES=y
BR2_PACKAGE_NGINX=y
BR2_PACKAGE_NGINX_HTTP_SSL_MODULE=y
BR2_PACKAGE_NGINX_HTTP_REALIP_MODULE=y
BR2_PACKAGE_NGINX_HTTP_AUTH_REQUEST_MODULE=y
BR2_PACKAGE_NTP=y
BR2_PACKAGE_NTP_SNTP=y
BR2_PACKAGE_NTP_NTPDATE=y
BR2_PACKAGE_NTP_NTPQ=y
BR2_PACKAGE_NTP_NTPTIME=y
BR2_PACKAGE_NTP_TICKADJ=y
BR2_PACKAGE_PHYTOOL=y
BR2_PACKAGE_RSYNC=y
BR2_PACKAGE_WPA_SUPPLICANT=y
# BR2_PACKAGE_URANDOM_SCRIPTS is not set
BR2_PACKAGE_BASH_COMPLETION=y
BR2_PACKAGE_INOTIFY_TOOLS=y
BR2_PACKAGE_LOGROTATE=y
BR2_PACKAGE_TIME=y
BR2_PACKAGE_COREUTILS=y
BR2_PACKAGE_HTOP=y
BR2_PACKAGE_KMOD=y
BR2_PACKAGE_KMOD_TOOLS=y
BR2_PACKAGE_PROCPS_NG=y
BR2_PACKAGE_RSYSLOG=y
BR2_PACKAGE_START_STOP_DAEMON=y
BR2_PACKAGE_TAR=y
BR2_PACKAGE_UTIL_LINUX_HWCLOCK=y
BR2_PACKAGE_UTIL_LINUX_LOGGER=y
BR2_PACKAGE_UTIL_LINUX_LOSETUP=y
BR2_PACKAGE_UTIL_LINUX_MOUNT=y
BR2_PACKAGE_UTIL_LINUX_MOUNTPOINT=y
BR2_PACKAGE_UTIL_LINUX_NOLOGIN=y
BR2_PACKAGE_UTIL_LINUX_SCHEDUTILS=y
BR2_PACKAGE_NANO=y
BR2_TARGET_ROOTFS_JFFS2=y
BR2_TARGET_ROOTFS_JFFS2_NOCLEANMARKER=y
BR2_TARGET_ROOTFS_JFFS2_PAD=y
BR2_TARGET_ROOTFS_JFFS2_SUMMARY=y
BR2_TARGET_ROOTFS_JFFS2_USE_CUSTOM_PAGESIZE=y
BR2_TARGET_ROOTFS_TAR_GZIP=y
BR2_PACKAGE_HOST_E2FSPROGS=y
BR2_PACKAGE_HOST_ENVIRONMENT_SETUP=y
BR2_PACKAGE_HOST_QEMU=y
BR2_PACKAGE_HOST_QEMU_SYSTEM_MODE=y
```

## package/libpam-policycache/Config.in
```kconfig
config BR2_PACKAGE_LIBPAM_POLICYCACHE
	bool "libpam-policycache"
	depends on BR2_PACKAGE_LINUX_PAM
	depends on BR2_TOOLCHAIN_HAS_THREADS # libglib2
	depends on BR2_USE_WCHAR # libglib2
	depends on BR2_USE_MMU # libglib2
	select BR2_PACKAGE_LIBGLIB2
	select BR2_PACKAGE_LIBSCRYPT
	help
	  Password caching module with advanced policies for PAM.

	  Allows offline authentication when the primary authentication
	  server is unavailable, with configurable cache lifetime and
	  policy rules.

	  Note: This repository is archived and no longer maintained
	  by Google as of January 2023.

	  https://github.com/google/libpam-policycache

comment "libpam-policycache needs a toolchain w/ threads, wchar"
	depends on BR2_USE_MMU
	depends on BR2_PACKAGE_LINUX_PAM
	depends on !BR2_TOOLCHAIN_HAS_THREADS || !BR2_USE_WCHAR
```
